## board/contactless/mx6ul_wirenboard/Kconfig
```kconfig
if TARGET_MX6UL_WIRENBOARD

config SYS_BOARD
	default "mx6ul_wirenboard"

config SYS_VENDOR
	default "contactless"

config SYS_CONFIG_NAME
	default "mx6ul_wirenboard"

endif
```

## configs/mx6ul_wirenboard6_defconfig
```kconfig
CONFIG_ARM=y
CONFIG_ARCH_MX6=y
CONFIG_TARGET_MX6UL_WIRENBOARD=y
CONFIG_SYS_EXTRA_OPTIONS="IMX_CONFIG=board/contactless/mx6ul_wirenboard/imximage.cfg"
CONFIG_CMD_GPIO=y
CONFIG_CMD_DHCP=y
CONFIG_CMD_PING=y
```
